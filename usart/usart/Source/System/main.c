/****************************************Copyright (c)******************************************
**
**                懿航工作室   Copyright(C) 2011, Yehhon ,All rights reserved.
**
**-------------------------------------文件信息--------------------------------------------
  **  文 件 名:    main.c
  **  描    述:    主程序文件
  **  创 建 人:    Devil
**--------------------------------------------------------------------------------------------
  **  修改历史:
  **  2011/09/19   Devil   建立
************************************************************************************************/
/* 系统头文件 */
#include "stdio.h"
/* 库文件头 */
#include "stm32f10x.h"
/* 类型定义文件 */
#include "../YH_Clib/YH_Type.h"

/* 本地声明头 */
#define YH_MAIN_LOCAL
#include "allinclude.h"

INT32U Systick = 0;

/*************************************************************************************************
** 函数名称:    System_Init
** 功能描述: 	系统初始化函数
** 输　  入:    无
** 输　  出:    无
** 返 回 值:    无
** 先决条件:
** 全局变量:
** 调用模块:
**--------------------------------------------------------------------------------------------
** 修改记录:
** 2011/09/19   Devil   建立
*************************************************************************************************/
void System_Init(void)
{
	/* 优先打开 I2C 时钟 */
		#if Esp_Ap_Sta == 1
	delay_ms(1000);
	#else
		INT16U time_e = rand() % 200 + 1000;
	delay_ms(time_e);
	#endif
    /* 外设时钟统一在这里打开  */
    RCC_APB2PeriphClockCmd(RCC_APB2Periph_GPIOA | RCC_APB2Periph_AFIO,ENABLE);
    RCC_APB2PeriphClockCmd(RCC_APB2Periph_GPIOB,ENABLE);
    RCC_APB2PeriphClockCmd(RCC_APB2Periph_TIM1,ENABLE);
    RCC_APB1PeriphClockCmd(RCC_APB1Periph_USART3,ENABLE);


    /* 串口3初始化，用于485总线，DMA发送，队列接受 */
  //  STM32_U3_OPEN(9600,USART_StopBits_1,USART_Parity_No);
		//STM32_U2_OPEN(9600,USART_StopBits_1,USART_Parity_No);
	STM32_U1_OPEN(9600,USART_StopBits_1,USART_Parity_No);
    /* 近接感应复位并初始化 */
	InitRc522();
	esp8266_init();
	#if Esp_Ap_Sta == 1
	Button_Read_Init();
	
	#endif
	printf("Hello world\r\n");
    /* 开启系统滴答定时器 */
    SysTick_Config(SystemCoreClock / 1000);
}

/*************************************************************************************************
** 函数名称:    main
** 功能描述: 	主函数
** 输　  入:    无
** 输　  出:    无
** 返 回 值:    无
** 先决条件:
** 全局变量:
** 调用模块:
**--------------------------------------------------------------------------------------------
** 修改记录:
** 2011/09/19   Devil   建立
*************************************************************************************************/
int main(void)
{
    /* 系统初始化 */
	int i = 2;
    System_Init();
	#if Esp_Ap_Sta == 1
		while(i--)
		{
			Get_Frist_To_Ap();
			if(GET_MS_SIG(MSGMANAGE_MS) > 300)
			{
				CLR_MS_SIG(MSGMANAGE_MS);
					Control_Delay_Task();
					
			}
		}
		#endif
	//	delay_ms(300);
		
    while(1)
    {
        /* 按键读取任务 */
       // Button_Read_Task();

			Rc522_Task();
			
			if(GET_MS_SIG(MSGMANAGE_MS) > 300)
			{
				CLR_MS_SIG(MSGMANAGE_MS);
					Control_Delay_Task();
					
			}
			
			Button_Read_Task();
			LogicRun_Task();
			#if Esp_Ap_Sta == 1
		
			
			Get_Info_To_Ap();
			
				MsgManage_Task();
			#endif
    }
}
/*************************************************************************************************
** 函数名称:    SysTick_Handler
** 功能描述: 	中断,间隔1Ms
** 输　  入:    无
** 输　  出:    无
** 返 回 值:    无
** 先决条件:
** 全局变量:
** 调用模块:
**--------------------------------------------------------------------------------------------
** 修改记录:
** 2011/09/19   Devil   建立
*************************************************************************************************/
void SysTick_Handler(void)
{
    INT32U i;

    Systick++;

    for(i=0; i<SYS_SIG1MS_MAX; i++)
    {
        Sys_Sig1ms[i]++;
    }
	
}
/*************************************************************************************************
** 函数名称:    Get_Systick
** 功能描述: 	获得系统时钟
** 输　  入:    无
** 输　  出:    无
** 返 回 值:    无
** 先决条件:
** 全局变量:
** 调用模块:
**--------------------------------------------------------------------------------------------
** 修改记录:
** 2011/09/19   Devil   建立
*************************************************************************************************/
INT32U Get_Systick(void)
{
    return Systick;
}
int fputc(int ch, FILE* stream)
{
    //SendOneByte(ch);
	delay_ms(1);
	STM32_U1_Write((INT8U*)&ch,1);
    return ch;
}

/************************************************************************************************
						                 END FILE
************************************************************************************************/
