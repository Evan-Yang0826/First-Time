/****************************************Copyright (c)******************************************
**                                                                                              
**                懿航工作室   Copyright(C) 2011, Yehhon ,All rights reserved.                  
**                                                                                              
**----------------------------------------文件信息----------------------------------------------
  **  文 件 名:    STM32_I2CM.c
  **  描    述:    STM32 IO模拟I2C
  **  创 建 人:    Devil
**----------------------------------------------------------------------------------------------
  **  修改历史:    
  **  2018/10/12   Devil    创建
************************************************************************************************/
/* 系统头文件 */
#include "stdio.h"
/* 库文件头 */
#include "stm32f10x.h"
#include "../YH_Clib/YH_Type.h"
#include "../STM32_delay/STM32_delay.h"

/* 本地头文件 */
#define STM32_I2CM_LOCAL
#include "STM32_I2CM.h"

enum ENUM_TWI_REPLY
{
	TWI_NACK=0,
	TWI_ACK=1
};

enum ENUM_TWI_BUS_STATE
{
	TWI_READY=0,
	TWI_BUS_BUSY=1,
	TWI_BUS_ERROR=2
};
/*************************************************************************************************
** 函数名称:	I2C1_Iint
** 功能描述:	I2C1初始化 
** 输　  入: 	无
** 输　  出: 	无     
** 返 回 值: 	无
** 全局变量: 
** 调用模块: 
**
** 作　  者: 	
** 日　  期: 
**--------------------------------------------------------------------------------------------
** 修 改 人:
** 日　  期:
**--------------------------------------------------------------------------------------------
*************************************************************************************************/
void I2C1_Init(void)
{
	GPIO_InitTypeDef  GPIO_Initstruct;
	
	/* 需要的IO口初始化 */
	
	GPIO_Initstruct.GPIO_Pin = GPIO_Pin_7 ;
	GPIO_Initstruct.GPIO_Speed = GPIO_Speed_50MHz;
	GPIO_Initstruct.GPIO_Mode = GPIO_Mode_Out_PP;
	GPIO_Init(GPIOB,&GPIO_Initstruct);
	
	GPIO_Initstruct.GPIO_Pin =  GPIO_Pin_6;
	GPIO_Initstruct.GPIO_Speed = GPIO_Speed_50MHz;
	GPIO_Initstruct.GPIO_Mode = GPIO_Mode_Out_PP;
	GPIO_Init(GPIOB,&GPIO_Initstruct);
	
}
/*************************************************************************************************
** 函数名称:	I2CDelay
** 功能描述:	 
** 输　  入: 	无
** 输　  出: 	无     
** 返 回 值: 	无
** 全局变量: 
** 调用模块: 
**
** 作　  者: 	易仕尧	
** 日　  期: 	2011/08/11
**--------------------------------------------------------------------------------------------
** 修 改 人:
** 日　  期:
**--------------------------------------------------------------------------------------------
*************************************************************************************************/
void I2CDelay(INT32U m)
{
	while(m--);
}
/*************************************************************************************************
** 函数名称:	TWI_START
** 功能描述:	IIC发送起始信号 
** 输　  入: 	无
** 输　  出: 	无     
** 返 回 值: 	无
** 全局变量: 
** 调用模块: 
**
** 作　  者: 	易仕尧	
** 日　  期: 	2011/08/11
**--------------------------------------------------------------------------------------------
** 修 改 人:
** 日　  期:
**--------------------------------------------------------------------------------------------
*************************************************************************************************/
INT8U I2CM_START(void)
{ 
 	TWI_SDA_1; 
 	TWI_NOP;
   
 	TWI_SCL_1; 
 	TWI_NOP;    

 	if(!TWI_SDA_STATE)
 	{
  		return TWI_BUS_BUSY;
 	}

 	TWI_SDA_0;
 	TWI_NOP;
  
 	TWI_SCL_0;  
 	TWI_NOP; 

 	if(TWI_SDA_STATE)
 	{
  		return TWI_BUS_ERROR;
 	} 
 
 	return TWI_READY; 	//IIC已准备好
}

/*************************************************************************************************
** 函数名称:	TWI_STOP
** 功能描述:	IIC发送停止信号 
** 输　  入: 	无
** 输　  出: 	无     
** 返 回 值: 	无
** 全局变量: 
** 调用模块: 
**
** 作　  者: 	易仕尧	
** 日　  期: 	2011/08/11
**--------------------------------------------------------------------------------------------
** 修 改 人:
** 日　  期:
**--------------------------------------------------------------------------------------------
*************************************************************************************************/
void I2CM_STOP(void)
{ 	
	TWI_SCL_0; 
// 	TWI_NOP;   
	
 	TWI_SDA_0; 
 	TWI_NOP;
   
 	TWI_SCL_1; 
 	TWI_NOP;    

 	TWI_SDA_1;
 	TWI_NOP;  
}
/*************************************************************************************************
** 函数名称:	TWI_SendACK
** 功能描述:	IIC发送应答信号 
** 输　  入: 	无
** 输　  出: 	无     
** 返 回 值: 	无
** 全局变量: 
** 调用模块: 
**
** 作　  者: 	易仕尧	
** 日　  期: 	2011/08/11
**--------------------------------------------------------------------------------------------
** 修 改 人:
** 日　  期:
**--------------------------------------------------------------------------------------------
*************************************************************************************************/
void TWI_SendACK(void)
{
 	TWI_SDA_0;
 	TWI_NOP;
 	TWI_SCL_1;
 	TWI_NOP;
 	TWI_SCL_0; 
 	TWI_NOP;  
}

/*************************************************************************************************
** 函数名称:	TWI_SendNACK
** 功能描述:	IIC发送非应答信号 
** 输　  入: 	无
** 输　  出: 	无     
** 返 回 值: 	无
** 全局变量: 
** 调用模块: 
**
** 作　  者: 	易仕尧	
** 日　  期: 	2011/08/11
**--------------------------------------------------------------------------------------------
** 修 改 人:
** 日　  期:
**--------------------------------------------------------------------------------------------
*************************************************************************************************/
void TWI_SendNACK(void)
{
	TWI_SCL_0; 
 	TWI_NOP;
 	TWI_SDA_1;
 	TWI_NOP;
 	TWI_SCL_1;
 	TWI_NOP;
 	TWI_SCL_0; 
 	TWI_NOP;   
}
/*************************************************************************************************
** 函数名称:	TWI_SendByte
** 功能描述:	IIC发送字节 
** 输　  入: 	无
** 输　  出: 	无     
** 返 回 值: 	无
** 全局变量: 
** 调用模块: 
**
** 作　  者: 	易仕尧	
** 日　  期: 	2011/08/11
**--------------------------------------------------------------------------------------------
** 修 改 人:
** 日　  期:
**--------------------------------------------------------------------------------------------
*************************************************************************************************/
INT8U I2CM_SendByte(INT8U Data)
{
 	INT8U i;
	

	
 	TWI_SCL_0;
 	for(i=0;i<8;i++)
 	{  
  		//---------数据建立----------
  		if(Data&0x80)
  		{
   			TWI_SDA_1;
  		}
  		else
  		{
   			TWI_SDA_0;
  		} 
  		Data<<=1;
  		TWI_NOP;
  		//---数据建立保持一定延时----
  
  		//----产生一个上升沿[正脉冲] 
  		TWI_SCL_1;
  		TWI_NOP;
  		TWI_SCL_0;
  		TWI_NOP;//延时,防止SCL还没变成低时改变SDA,从而产生START/STOP信号
  		//---------------------------   
	}
 	//接收从机的应答 
 	TWI_SDA_1; 
 	TWI_NOP;
 	TWI_SCL_1;
 	TWI_NOP;  
	TWI_NOP;	
 	if(TWI_SDA_STATE)
 	{
  		TWI_SCL_0;
  		return TWI_NACK;
 	}
 	else
 	{
  		TWI_SCL_0;
  		return TWI_ACK;  
 	}    
}

/*************************************************************************************************
** 函数名称:	TWI_ReceiveByte
** 功能描述:	IIC接收字节 
** 输　  入: 	无
** 输　  出: 	无     
** 返 回 值: 	无
** 全局变量: 
** 调用模块: 
**
** 作　  者: 	易仕尧	
** 日　  期: 	2011/08/11
**--------------------------------------------------------------------------------------------
** 修 改 人:
** 日　  期:
**--------------------------------------------------------------------------------------------
*************************************************************************************************/
INT8U I2CM_ReceiveByte(void)
{
 	INT8U i,Dat;
	
	//SDA 输入模式
 	TWI_SDA_IN;
// 	TWI_SDA_1;
 	//TWI_SCL_0; 
 	Dat=0;
 	for(i=0;i<8;i++)
 	{
		TWI_SCL_0;//准备好接收数据  
  		TWI_NOP;//等待数据准备好
  		TWI_SCL_1;//产生时钟上升沿[正脉冲],让从机准备好数据 
  		TWI_NOP;
		
  		Dat<<=1;
  		if(TWI_SDA_STATE) //读引脚状态
  		{
   			Dat|=0x01; 
  		}            
 	}
	TWI_SDA_OUT;
	TWI_SendNACK();
 	return Dat;
}
/*************************************************************************************************
** 函数名称:	I2C1_ReadData
** 功能描述:	I2C1读取随机位置指定长度
** 输　  入: 	无
** 输　  出: 	无     
** 返 回 值: 	无
** 全局变量: 
** 调用模块: 
**
** 作　  者: 	
** 日　  期: 
**--------------------------------------------------------------------------------------------
** 修 改 人:
** 日　  期:
**--------------------------------------------------------------------------------------------
*************************************************************************************************/
INT32U I2C1_ReadData(INT8U SLA,INT16U SubAddr,INT8U *DataBuf,INT32U Long)
{
	INT32U i;

	I2CM_START();
	I2CM_SendByte(SLA);
//	TWI_SendByte(SubAddr>>8);	
	I2CM_SendByte(SubAddr);
	I2CM_START();
	I2CM_SendByte(SLA|0x01);
	
	for(i=0;i<Long;i++)
	{
		DataBuf[i]=I2CM_ReceiveByte();
		TWI_SendACK();	
	}
	I2CM_STOP();		
	return i;
}
/************************************************************************************************
                                         END FILE                                                
************************************************************************************************/
