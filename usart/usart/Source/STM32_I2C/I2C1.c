/*************************************************************************************************
**
**    http://www.aoretech.cn/main.asp  Copyright(C) 2010, YMHX ,All rights reserved.
**
**-----------------------------------------文件信息-----------------------------------------------
**  文 件 名: 	   I2C1.c
**  描    述: 	   I2C1驱动
**  创 建 人: 
**  修改历史:  	   2011/6/15
*************************************************************************************************/
#include <stm32f10x_lib.h>
#include <stm32f10x_map.h>
#include <stm32_reg.h>

#include "../YMHX_CLib/type.h"
#include "../EDeviceManage/TIMER/timer3.h"
#define  I2C1_LOCAL
#include "I2C1.h"

enum ENUM_TWI_REPLY
{
	TWI_NACK=0,
	TWI_ACK=1
};

enum ENUM_TWI_BUS_STATE
{
	TWI_READY=0,
	TWI_BUS_BUSY=1,
	TWI_BUS_ERROR=2
};

#if USE_HARDI2C
/*************************************************************************************************
** 函数名称:	I2C1_Iint
** 功能描述:	I2C1初始化 
** 输　  入: 	无
** 输　  出: 	无     
** 返 回 值: 	无
** 全局变量: 
** 调用模块: 
**
** 作　  者: 	
** 日　  期: 
**--------------------------------------------------------------------------------------------
** 修 改 人:
** 日　  期:
**--------------------------------------------------------------------------------------------
*************************************************************************************************/
INT32U waitForEvent(INT32U event)
{
	INT32U S;
	CLR_20MS_SIG(I2C1_SIG20MS);
  	while(1)
	{
    	S = I2C1->SR1;
    	if (S & event) return S;
		if(GET_20MS_SIG(I2C1_SIG20MS)>2) return 0;
	}
}

/*************************************************************************************************
** 函数名称:	sendStart
** 功能描述:	I2C1发送起始位 
** 输　  入: 	无
** 输　  出: 	无     
** 返 回 值: 	无
** 全局变量: 
** 调用模块: 
**
** 作　  者: 	
** 日　  期: 
**--------------------------------------------------------------------------------------------
** 修 改 人:
** 日　  期:
**--------------------------------------------------------------------------------------------
*************************************************************************************************/
void sendStart(INT8U SLA)
{
	I2C1->CR1 |= 1<<8;									// send start when bus becomes available
	waitForEvent(I2C_FLAG_SB);
	I2C1->DR = SLA;										// send slave address for transmission
	waitForEvent(I2C_FLAG_ADDR);
	I2C1->SR2;											// clear event
}
/*************************************************************************************************
** 函数名称:	sendData
** 功能描述:	I2C1发送数据 
** 输　  入: 	无
** 输　  出: 	无     
** 返 回 值: 	无
** 全局变量: 
** 调用模块: 
**
** 作　  者: 	
** 日　  期: 
**--------------------------------------------------------------------------------------------
** 修 改 人:
** 日　  期:
**--------------------------------------------------------------------------------------------
*************************************************************************************************/
void sendData(u8 data)
{
  	waitForEvent(I2C_FLAG_BTF);
  	I2C1->DR = data;											// send byte
}
/*************************************************************************************************
** 函数名称:	sendStop
** 功能描述:	I2C1发送停止位 
** 输　  入: 	无
** 输　  出: 	无     
** 返 回 值: 	无
** 全局变量: 
** 调用模块: 
**
** 作　  者: 	
** 日　  期: 
**--------------------------------------------------------------------------------------------
** 修 改 人:
** 日　  期:
**--------------------------------------------------------------------------------------------
*************************************************************************************************/
void sendStop(void)
{
  	waitForEvent(I2C_FLAG_TXE);
  	I2C1->CR1 |= 1<<9;											// send stop after current byte
}
/*************************************************************************************************
** 函数名称:	receiveByte
** 功能描述:	 
** 输　  入: 	无
** 输　  出: 	无     
** 返 回 值: 	无
** 全局变量: 
** 调用模块: 
**
** 作　  者: 	
** 日　  期: 
**--------------------------------------------------------------------------------------------
** 修 改 人:
** 日　  期:
**--------------------------------------------------------------------------------------------
*************************************************************************************************/
INT8U receiveByte(INT8U SLA) 
{
  	I2C1->CR1 |= 1<<8;										// send start when bus becomes available
  	waitForEvent(I2C_FLAG_SB);
  	I2C1->CR1 &=~(1<<10);									// only one byte will be read
  	I2C1->DR = SLA | 0x01;									// send slave address for reception
  	waitForEvent(I2C_FLAG_ADDR);
  	I2C1->SR2;												// clear event

  	waitForEvent(I2C_FLAG_RXNE);
  	I2C1->CR1 |= 1<<9;										// send stop after current byte
  	return I2C1->DR;										// receive byte
}
/*************************************************************************************************
** 函数名称:	I2C1_Iint
** 功能描述:	I2C1初始化 
** 输　  入: 	无
** 输　  出: 	无     
** 返 回 值: 	无
** 全局变量: 
** 调用模块: 
**
** 作　  者: 	
** 日　  期: 
**--------------------------------------------------------------------------------------------
** 修 改 人:
** 日　  期:
**--------------------------------------------------------------------------------------------
*************************************************************************************************/
void I2C1_Iint(void)
{
	RCC->APB1ENR |= 1;
	RCC->APB1ENR |= RCC_APB1Periph_I2C1;
	RCC->APB1RSTR |= RCC_APB1Periph_I2C1;
	RCC->APB1RSTR &= ~RCC_APB1Periph_I2C1;
	I2C1->CCR=0x00B4;
	I2C1->OAR1=0x40A0;
	I2C1->TRISE=0x0025;
	I2C1->CR2=0x0024;
	I2C1->CR1=0X0001;	
}
	u8 ReadByte(u16 addr) {
  /* Enable I2C1 acknowledgement if it is already disabled by other function */
  //I2C_AcknowledgeConfig(I2C1, ENABLE);

  sendStart(0XA0);
  sendData( addr & 0xFF );
  //sendStart();
  //sendStop();
  return receiveByte(0xa0);
  }
/*************************************************************************************************
** 函数名称:	I2C1_ReadData
** 功能描述:	I2C1读取随机位置指定长度
** 输　  入: 	无
** 输　  出: 	无     
** 返 回 值: 	无
** 全局变量: 
** 调用模块: 
**
** 作　  者: 	
** 日　  期: 
**--------------------------------------------------------------------------------------------
** 修 改 人:
** 日　  期:
**--------------------------------------------------------------------------------------------
*************************************************************************************************/
INT32U I2C1_ReadData(INT8U SLA,INT16U SubAddr,INT8U *DataBuf,INT32U Long)
{
	INT32U i;

	sendStart(SLA);
		
//	sendData(SubAddr>>8);
	sendData(SubAddr);
	
	sendStart(SLA|0x01);
	
	for(i=0;i<Long;i++)
	{

		I2C1->CR1 |=(1<<10);
		waitForEvent(I2C_FLAG_RXNE);
		DataBuf[i]=I2C1->DR;	
	}
	I2C1->CR1 &=~(1<<10);
	I2C1->CR1 |= 1<<9;		

	return i;
}

void WriteByte(u16 addr, u8 data) 
{
  sendStart(0xa0);
  sendData( addr & 0xFF );
  sendData( data );
  waitForEvent(I2C_FLAG_BTF);
  sendStop();
}

void Writestring(INT16U addr, INT8S *data,INT16U Long) 
{
	INT16U i=0,j;
	for(i=0;i<Long;i++)
	{
 		WriteByte(addr+i,data[i]);
		for(j=0;j<200;j++);
	}
}
#else
/*************************************************************************************************
** 函数名称:	I2C1_Iint
** 功能描述:	I2C1初始化 
** 输　  入: 	无
** 输　  出: 	无     
** 返 回 值: 	无
** 全局变量: 
** 调用模块: 
**
** 作　  者: 	
** 日　  期: 
**--------------------------------------------------------------------------------------------
** 修 改 人:
** 日　  期:
**--------------------------------------------------------------------------------------------
*************************************************************************************************/
void I2C1_Iint(void)
{
}
/*************************************************************************************************
** 函数名称:	I2CDelay
** 功能描述:	 
** 输　  入: 	无
** 输　  出: 	无     
** 返 回 值: 	无
** 全局变量: 
** 调用模块: 
**
** 作　  者: 	易仕尧	
** 日　  期: 	2011/08/11
**--------------------------------------------------------------------------------------------
** 修 改 人:
** 日　  期:
**--------------------------------------------------------------------------------------------
*************************************************************************************************/
void I2CDelay(INT32U m)
{
	while(m--);
}
/*************************************************************************************************
** 函数名称:	TWI_START
** 功能描述:	IIC发送起始信号 
** 输　  入: 	无
** 输　  出: 	无     
** 返 回 值: 	无
** 全局变量: 
** 调用模块: 
**
** 作　  者: 	易仕尧	
** 日　  期: 	2011/08/11
**--------------------------------------------------------------------------------------------
** 修 改 人:
** 日　  期:
**--------------------------------------------------------------------------------------------
*************************************************************************************************/
static INT8U TWI_START(void)
{ 
 	TWI_SDA_1; 
 	TWI_NOP;
   
 	TWI_SCL_1; 
 	TWI_NOP;    

 	if(!TWI_SDA_STATE)
 	{
  		return TWI_BUS_BUSY;
 	}

 	TWI_SDA_0;
 	TWI_NOP;
  
 	TWI_SCL_0;  
 	TWI_NOP; 

 	if(TWI_SDA_STATE)
 	{
  		return TWI_BUS_ERROR;
 	} 
 
 	return TWI_READY; 	//IIC已准备好
}

/*************************************************************************************************
** 函数名称:	TWI_STOP
** 功能描述:	IIC发送停止信号 
** 输　  入: 	无
** 输　  出: 	无     
** 返 回 值: 	无
** 全局变量: 
** 调用模块: 
**
** 作　  者: 	易仕尧	
** 日　  期: 	2011/08/11
**--------------------------------------------------------------------------------------------
** 修 改 人:
** 日　  期:
**--------------------------------------------------------------------------------------------
*************************************************************************************************/
void TWI_STOP(void)
{
 	TWI_SDA_0; 
 	TWI_NOP;
   
 	TWI_SCL_1; 
 	TWI_NOP;    

 	TWI_SDA_1;
 	TWI_NOP;  
}
/*************************************************************************************************
** 函数名称:	TWI_SendACK
** 功能描述:	IIC发送应答信号 
** 输　  入: 	无
** 输　  出: 	无     
** 返 回 值: 	无
** 全局变量: 
** 调用模块: 
**
** 作　  者: 	易仕尧	
** 日　  期: 	2011/08/11
**--------------------------------------------------------------------------------------------
** 修 改 人:
** 日　  期:
**--------------------------------------------------------------------------------------------
*************************************************************************************************/
void TWI_SendACK(void)
{
 	TWI_SDA_0;
 	TWI_NOP;
 	TWI_SCL_1;
 	TWI_NOP;
 	TWI_SCL_0; 
 	TWI_NOP;  
}

/*************************************************************************************************
** 函数名称:	TWI_SendNACK
** 功能描述:	IIC发送非应答信号 
** 输　  入: 	无
** 输　  出: 	无     
** 返 回 值: 	无
** 全局变量: 
** 调用模块: 
**
** 作　  者: 	易仕尧	
** 日　  期: 	2011/08/11
**--------------------------------------------------------------------------------------------
** 修 改 人:
** 日　  期:
**--------------------------------------------------------------------------------------------
*************************************************************************************************/
void TWI_SendNACK(void)
{
 	TWI_SDA_1;
 	TWI_NOP;
 	TWI_SCL_1;
 	TWI_NOP;
 	TWI_SCL_0; 
 	TWI_NOP;   
}
/*************************************************************************************************
** 函数名称:	TWI_SendByte
** 功能描述:	IIC发送字节 
** 输　  入: 	无
** 输　  出: 	无     
** 返 回 值: 	无
** 全局变量: 
** 调用模块: 
**
** 作　  者: 	易仕尧	
** 日　  期: 	2011/08/11
**--------------------------------------------------------------------------------------------
** 修 改 人:
** 日　  期:
**--------------------------------------------------------------------------------------------
*************************************************************************************************/
static INT8U TWI_SendByte(INT8U Data)
{
 	INT8U i;
 	TWI_SCL_0;
 	for(i=0;i<8;i++)
 	{  
  		//---------数据建立----------
  		if(Data&0x80)
  		{
   			TWI_SDA_1;
  		}
  		else
  		{
   			TWI_SDA_0;
  		} 
  		Data<<=1;
  		TWI_NOP;
  		//---数据建立保持一定延时----
  
  		//----产生一个上升沿[正脉冲] 
  		TWI_SCL_1;
  		TWI_NOP;
  		TWI_SCL_0;
  		TWI_NOP;//延时,防止SCL还没变成低时改变SDA,从而产生START/STOP信号
  		//---------------------------   
	}
 	//接收从机的应答 
 	TWI_SDA_1; 
 	TWI_NOP;
 	TWI_SCL_1;
 	TWI_NOP;   
 	if(TWI_SDA_STATE)
 	{
  		TWI_SCL_0;
  		return TWI_NACK;
 	}
 	else
 	{
  		TWI_SCL_0;
  		return TWI_ACK;  
 	}    
}

/*************************************************************************************************
** 函数名称:	TWI_ReceiveByte
** 功能描述:	IIC接收字节 
** 输　  入: 	无
** 输　  出: 	无     
** 返 回 值: 	无
** 全局变量: 
** 调用模块: 
**
** 作　  者: 	易仕尧	
** 日　  期: 	2011/08/11
**--------------------------------------------------------------------------------------------
** 修 改 人:
** 日　  期:
**--------------------------------------------------------------------------------------------
*************************************************************************************************/
static INT8U TWI_ReceiveByte(void)
{
 	INT8U i,Dat;
 	TWI_SDA_1;
 	TWI_SCL_0; 
 	Dat=0;
 	for(i=0;i<8;i++)
 	{
  		TWI_SCL_1;//产生时钟上升沿[正脉冲],让从机准备好数据 
  		TWI_NOP; 
  		Dat<<=1;
  		if(TWI_SDA_STATE) //读引脚状态
  		{
   			Dat|=0x01; 
  		}   
  		TWI_SCL_0;//准备好再次接收数据  
  		TWI_NOP;//等待数据准备好         
 	}
 	return Dat;
}
/*************************************************************************************************
** 函数名称:	I2C1_ReadData
** 功能描述:	I2C1读取随机位置指定长度
** 输　  入: 	无
** 输　  出: 	无     
** 返 回 值: 	无
** 全局变量: 
** 调用模块: 
**
** 作　  者: 	
** 日　  期: 
**--------------------------------------------------------------------------------------------
** 修 改 人:
** 日　  期:
**--------------------------------------------------------------------------------------------
*************************************************************************************************/
INT32U I2C1_ReadData(INT8U SLA,INT16U SubAddr,INT8U *DataBuf,INT32U Long)
{
	INT32U i;

	TWI_START();
	TWI_SendByte(SLA);
//	TWI_SendByte(SubAddr>>8);	
	TWI_SendByte(SubAddr);
	TWI_START();
	TWI_SendByte(SLA|0x01);
	
	for(i=0;i<Long;i++)
	{
		DataBuf[i]=TWI_ReceiveByte();
		TWI_SendACK();	
	}
	TWI_STOP();		
	return i;
}
#endif

