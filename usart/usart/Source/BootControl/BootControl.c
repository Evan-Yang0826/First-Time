/****************************************Copyright (c)******************************************
**-------------------------------------文件信息--------------------------------------------
  **  文 件 名:    BootControl.c 
  **  描    述:    所能STM32单片机 代码启动权限控制
  **  创 建 人:    Joshua
**--------------------------------------------------------------------------------------------
  **  修改历史:
** 2018/10/15   Joshua   建立  
************************************************************************************************/
/* 库文件头 */
#include "stm32f10x.h"

/* 本地声明头 */
#define BOOTCONTROL_LOCAL
#include "BootControl.h"

volatile BOOTFIG_TYPE* BootFig = (BOOTFIG_TYPE *)BOOTFIG_ADDR;
/*************************************************************************************************
** 函数名称:    SN_Calc_CRC16
** 功能描述: 	16位CRC计算函数
** 输　  入:    无
** 输　  出:    无     
** 返 回 值:    无
** 先决条件: 
** 全局变量: 
** 调用模块: 
**--------------------------------------------------------------------------------------------
** 修改记录:
** 2018/10/15   Joshua   建立   
*************************************************************************************************/
unsigned short SN_Calc_CRC16(unsigned char *Data,unsigned int Mlong)
{
	unsigned char i;
	unsigned short CRCValue = 0;
	while(--Mlong)
	{
		for(i=0x80;i;i>>=1)
		{
			if(CRCValue & 0x8000)
			{
				CRCValue<<=1;
				CRCValue^=0x1021;
			}
			else CRCValue<<=1;

			if(*Data & i)
			{
				CRCValue^=0x1021;
			}
		}
		Data++;
	}
	return CRCValue;
}
/*************************************************************************************************
** 函数名称:    BLC_TestPassword
** 功能描述: 	启动ID码验证，如不正确，进入死循环
** 输　  入:    无
** 输　  出:    无     
** 返 回 值:    无
** 先决条件: 
** 全局变量: 
** 调用模块: 
**--------------------------------------------------------------------------------------------
** 修改记录:
** 2018/10/15   Joshua   建立   
*************************************************************************************************/
void BLC_CheckID(void)
{
	#if STM32_ID_CHECK
	unsigned char i;
	BOOTFIG_TYPE* bootfig = (BOOTFIG_TYPE *)BOOTFIG_ADDR;
	
	BOOTFIG_TYPE TempValue =
	{
		0xaa,
		1234,
		{0x00,0x00,0x00,0x00}
	};
	

	
	TempValue.Fig = 0x12;
	TempValue.CrcValue = SN_Calc_CRC16(MCU_ID_ADDR,12);

	for(i=0;i<4;i++)
	{
		TempValue.Xor[0] ^= *(MCU_ID_ADDR+i); 
		TempValue.Xor[1] ^= *(MCU_ID_ADDR+i+4); 
		TempValue.Xor[2] ^= *(MCU_ID_ADDR+i+8); 	
	}

	for(i=0;i<12;i++)
	{
		TempValue.Xor[3] ^= *(MCU_ID_ADDR+i); 	
	}

	// 数据验证
	for(i=0;i<4;i++)
	{
		if(TempValue.Xor[i] != bootfig->Xor[i])
		{
			while(1)
			{
				for(i=0;i<4;i++)
				{
					TempValue.Xor[0] ^= *(MCU_ID_ADDR+i); 
					TempValue.Xor[1] ^= *(MCU_ID_ADDR+i+4); 
					NVIC_SystemReset();
					TempValue.Xor[2] ^= *(MCU_ID_ADDR+i+8); 	
				}
			}
		}	
	}
	
	if(TempValue.CrcValue != bootfig->CrcValue)
	{
		while(1)
		{
			for(i=0;i<4;i++)
			{
				TempValue.Xor[3] ^= *(MCU_ID_ADDR+i); 
				NVIC_SystemReset();
				TempValue.Xor[3] ^= *(MCU_ID_ADDR+i); 
			}
		}
	}
	#endif
}
/*************************************************************************************************
** 函数名称:    BootControl
** 功能描述: 	STM32启动权限控制函数
** 输　  入:    无
** 输　  出:    无     
** 返 回 值:    无
** 先决条件: 
** 全局变量: 
** 调用模块: 
**--------------------------------------------------------------------------------------------
** 修改记录:
** 2018/10/15   Joshua   建立  
*************************************************************************************************/
void BootControl_Init(void)
{
	BLC_CheckID();
}
/*************************************************************************************************
** 函数名称:    STM32_GetMAC
** 功能描述: 	根据STM32身份ID，生成一个6字节MAC地址
** 输　  入:    无
** 输　  出:    无     
** 返 回 值:    无
** 先决条件: 
** 全局变量: 
** 调用模块: 
**--------------------------------------------------------------------------------------------
** 修改记录:
** 2018/10/15   Joshua   建立  
*************************************************************************************************/
void STM32_GetMAC(unsigned char *mac)
{
	unsigned char i;
	unsigned short crc;
	
	for(i=0;i<6;i++)
	{
		crc = SN_Calc_CRC16((unsigned char *)(MCU_ID_ADDR + 2*i),2);
		mac[i] = crc + (crc>>8);
	}
}

/************************************************************************************************
						                 END FILE
************************************************************************************************/
